## sdkconfig.defaults
```kconfig
# Moondeck ESP32-S3 SDK defaults
# ESP-IDF 5.2

# Target
CONFIG_IDF_TARGET="esp32s3"
CONFIG_IDF_TARGET_ESP32S3=y

# Flash size (4MB embedded flash)
CONFIG_ESPTOOLPY_FLASHSIZE_4MB=y
CONFIG_ESPTOOLPY_FLASHSIZE="4MB"

# CPU frequency
CONFIG_ESP32S3_DEFAULT_CPU_FREQ_160=y
CONFIG_ESP32S3_DEFAULT_CPU_FREQ_MHZ=160

# PSRAM
CONFIG_ESP32S3_SPIRAM_SUPPORT=y
CONFIG_SPIRAM=y
CONFIG_SPIRAM_MODE_OCT=y
CONFIG_SPIRAM_SPEED_80M=y
CONFIG_SPIRAM_BOOT_INIT=y
CONFIG_SPIRAM_USE_MALLOC=y
CONFIG_SPIRAM_MALLOC_ALWAYSINTERNAL=4096
CONFIG_SPIRAM_MALLOC_RESERVE_INTERNAL=32768

# LCD RGB panel
CONFIG_SOC_LCD_RGB_SUPPORTED=y
CONFIG_SOC_LCDCAM_SUPPORTED=y
CONFIG_LCD_RGB_ISR_IRAM_SAFE=n

# PSRAM for LCD frame buffer allocation
CONFIG_SPIRAM_ALLOW_STACK_EXTERNAL_MEMORY=y
CONFIG_SPIRAM_TRY_ALLOCATE_WIFI_LWIP=y

# WiFi
CONFIG_ESP32_WIFI_ENABLED=y
CONFIG_ESP32_WIFI_NVS_ENABLED=y
CONFIG_ESP32_WIFI_STATIC_RX_BUFFER_NUM=6
CONFIG_ESP32_WIFI_DYNAMIC_RX_BUFFER_NUM=16
CONFIG_ESP32_WIFI_STATIC_TX_BUFFER=y
CONFIG_ESP32_WIFI_TX_BUFFER_TYPE=0
CONFIG_ESP32_WIFI_STATIC_TX_BUFFER_NUM=8
CONFIG_ESP32_WIFI_ENABLE_WPA3_SAE=y
CONFIG_ESP32_WIFI_RX_BA_WIN=6

# Main task stack size (for Lua)
CONFIG_MAIN_TASK_STACK_SIZE=32768

# SPIFFS
CONFIG_SPIFFS_MAX_PARTITIONS=3

# Console/logging
CONFIG_CONSOLE_UART_DEFAULT=y
CONFIG_CONSOLE_UART_BAUDRATE=115200

# Partition table - custom partition table
CONFIG_PARTITION_TABLE_CUSTOM=y

# Watchdog
CONFIG_TASK_WDT_TIMEOUT_S=10

# Heap
CONFIG_HEAP_POISONING_COMPREHENSIVE=n
CONFIG_HEAP_TRACING_OFF=y

# Flash configuration
CONFIG_ESPTOOLPY_FLASHMODE_DIO=y
CONFIG_ESPTOOLPY_FLASHFREQ_80M=y

# ============================================
# BINARY SIZE OPTIMIZATIONS
# ============================================

# Disable unused components
CONFIG_BT_ENABLED=n
CONFIG_BLUEDROID_ENABLED=n
CONFIG_BLE_ENABLED=n
CONFIG_NIMBLE_ENABLED=n

# Disable MQTT (not used)
CONFIG_MQTT_PROTOCOL_5=n

# Disable mDNS (not used)
CONFIG_MDNS_MAX_SERVICES=0

# Disable WebSocket client (not used - using HTTP only)
CONFIG_WS_TRANSPORT=n

# Disable OTA (can re-enable if needed)
CONFIG_OTA_ALLOW_HTTP=n

# Disable unused network protocols
CONFIG_LWIP_PPP_SUPPORT=n
CONFIG_LWIP_SLIP_SUPPORT=n
CONFIG_LWIP_SNTP_MAX_SERVERS=1

# Reduce TLS overhead (keep only what's needed for HTTPS)
CONFIG_MBEDTLS_SSL_MAX_CONTENT_LEN=16384
CONFIG_MBEDTLS_ASYMMETRIC_CONTENT_LEN=y
CONFIG_MBEDTLS_SSL_IN_CONTENT_LEN=16384
CONFIG_MBEDTLS_SSL_OUT_CONTENT_LEN=4096

# Disable only obscure mbedTLS curves (keep common ones for HTTPS)
CONFIG_MBEDTLS_ECP_DP_SECP192R1_ENABLED=n
CONFIG_MBEDTLS_ECP_DP_SECP224R1_ENABLED=n
CONFIG_MBEDTLS_ECP_DP_BP256R1_ENABLED=n
CONFIG_MBEDTLS_ECP_DP_BP384R1_ENABLED=n
CONFIG_MBEDTLS_ECP_DP_BP512R1_ENABLED=n
CONFIG_MBEDTLS_ECP_DP_SECP192K1_ENABLED=n
CONFIG_MBEDTLS_ECP_DP_SECP224K1_ENABLED=n
CONFIG_MBEDTLS_ECP_DP_SECP256K1_ENABLED=n
# Keep these enabled for modern HTTPS:
# - SECP256R1 (P-256) - most common
# - SECP384R1 (P-384) - common fallback
# - CURVE25519 - used by Cloudflare, etc.

# Compiler optimizations for size
CONFIG_COMPILER_OPTIMIZATION_SIZE=y
CONFIG_COMPILER_OPTIMIZATION_ASSERTIONS_SILENT=y

# Reduce logging in release
CONFIG_LOG_DEFAULT_LEVEL_WARN=y
CONFIG_LOG_DEFAULT_LEVEL=2
CONFIG_LOG_MAXIMUM_LEVEL_WARN=y

# Disable debug features
CONFIG_FREERTOS_USE_TRACE_FACILITY=n
CONFIG_FREERTOS_USE_STATS_FORMATTING_FUNCTIONS=n
CONFIG_FREERTOS_GENERATE_RUN_TIME_STATS=n

# Suppress legacy I2C driver warning (esp-idf-hal uses old API, no migration available yet)
CONFIG_I2C_ENABLE_DEBUG_LOG=n
```
